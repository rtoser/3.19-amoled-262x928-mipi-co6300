## versions/AM319M262928ZS/examples/esp32p4-3.19-amoled-262x928-mipi-co6300-bringup/components/perf_probe/Kconfig
```kconfig
menu "Performance probe (perf_probe)"

config PERF_PROBE_ENABLE
    bool "Attach the LVGL performance probe and print serial telemetry"
    default y
    help
        Aggregates the LVGL display events into per-window [FRAME]/[CPU]/[ERR]
        serial lines: honest redraw/motion FPS, refresh/render/draw/flush
        timing percentiles, true cross-core CPU idle, heap and stack
        watermarks. Ported (trimmed) from the time-center perf probe.

config PERF_PROBE_WINDOW_MS
    int "Reporting window (ms)"
    depends on PERF_PROBE_ENABLE
    range 250 60000
    default 1000

endmenu
```

## versions/AM319M262928ZS/examples/esp32p4-3.19-amoled-262x928-mipi-co6300-bringup/main/Kconfig.projbuild
```kconfig
menu "Example Configuration (AM319M262928ZS bring-up)"

    config EXAMPLE_PIN_NUM_LCD_RST
        int "LCD RST GPIO (-1 = not wired, use DCS software reset)"
        range -1 54
        default 6

    config EXAMPLE_PIN_NUM_LCD_VCI_EN
        int "LCD VCI_EN GPIO (-1 = not wired, adapter pull-up keeps the panel powered)"
        range -1 54
        default 22

    config EXAMPLE_PIN_NUM_TOUCH_SDA
        int "Touch I2C SDA GPIO"
        range 0 54
        default 7

    config EXAMPLE_PIN_NUM_TOUCH_SCL
        int "Touch I2C SCL GPIO"
        range 0 54
        default 8

    config EXAMPLE_PIN_NUM_TOUCH_RST
        int "Touch RST GPIO (-1 = not wired, adapter RC releases it)"
        range -1 54
        default -1

    config EXAMPLE_PIN_NUM_TOUCH_INT
        int "Touch INT GPIO (-1 = not wired, touch is polled; when set, esp_lvgl_port reads only on INT edges)"
        range -1 54
        default -1

endmenu
```
